// User Bengali lyrics, adapted for BenchTwin N16R8 + ILI9341.
// Original six bitmaps and 45.558-second cues retained. Canvas-free drawing.
#include <SPI.h>
#include <Adafruit_GFX.h>
#include <Adafruit_ILI9341.h>
#include <math.h>
#define CS 1
#define DC 2
#define RST 6
#define SYNC_PIN 7
Adafruit_ILI9341 tft(CS,DC,RST);
const int W=160;
const int H=128;
const int NUM=6;
const int BW[6]={147,113,147,131,118,147};
const int BH[6]={19,19,16,18,21,17};
const uint8_t sprites[72][3108]={
{0,0,0,0,0,0,0,0,0,0,0,0,0,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0,0},
{0,0,0,0,0,0,0,0,0,0,0,0,0,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0,0},
{0,0,0,0,0,0,0,0,0,0,0,0,0,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0,0},
{0,0,0,0,0,0,0,0,0,0,0,0,0,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0,0},
{0,0,0,0,0,0,0,0,0,0,0,0,0,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0,0},
{0,0,0,0,0,0,0,0,0,0,0,0,0,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0,0},
{0,0,0,0,0,0,0,0,0,0,0,0,0,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0,0},
{0,0,0,0,0,0,0,0,0,0,0,0,0,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0,0},
{0,0,0,0,0,0,0,0,0,0,0,0,0,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0,0},
{0,0,0,0,0,0,0,0,0,0,0,0,0,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0,0},
{0,0,0,0,0,0,0,0,0,0,0,0,0,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0,0},
{0,0,0,0,0,0,0,0,0,0,0,0,0,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0,0},
{0,0,0,0,0,0,0,0,0,0,0,0,0,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0,0},
{0,0,0,0,0,0,0,0,0,0,0,0,0,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0,0},
{0,0,0,0,0,0,0,0,0,0,0,0,0,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0,0},
{0,0,0,0,0,0,0,0,0,0,0,0,0,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0,0},
{0,0,0,0,0,0,0,0,0,0,0,0,0,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0,0},
{0,0,0,0,0,0,0,0,0,0,0,0,0,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0,0},
{0,0,0,0,0,0,0,0,0,0,0,0,0,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0,0},
{0,0,0,0,0,0,0,0,0,0,0,0,0,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0,0},
{0,0,0,0,0,0,0,0,0,0,0,0,0,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0,0},
{0,0,0,0,0,0,0,0,0,0,0,0,0,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0,0},
{0,0,0,0,0,0,0,0,0,0,0,0,0,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0,0},
{0,0,0,0,0,0,0,0,0,0,0,0,0,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0,0},
{0,0,0,0,0,0,0,0,0,0,0,0,0,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0,0},
{0,0,0,0,0,0,0,0,0,0,0,0,0,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0,0},
{0,0,0,0,0,0,0,0,0,0,0,0,0,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0,0},
{0,0,0,0,0,0,0,0,0,0,0,0,0,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0,0},
{0,0,0,0,0,0,0,0,0,0,0,0,0,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0,0},
{0,0,0,0,0,0,0,0,0,0,0,0,0,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0,0},
{0,0,0,0,0,0,0,0,0,0,0,0,0,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0,0},
{0,0,0,0,0,0,0,0,0,0,0,0,0,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0,0},
{0,0,0,0,0,0,0,0,0,0,0,0,0,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0,0},
{0,0,0,0,0,0,0,0,0,0,0,0,0,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0,0},
{0,0,0,0,0,0,0,0,0,0,0,0,0,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0,0},
{0,0,0,0,0,0,0,0,0,0,0,0,0,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0,0},
{0,0,0,0,0,0,0,0,0,0,0,0,0,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0,0},
{0,0,0,0,0,0,0,0,0,0,0,0,0,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0,0},
{0,0,0,0,0,0,0,0,0,0,0,0,0,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0,0},
{0,0,0,0,0,0,0,0,0,0,0,0,0,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0,0},
{0,0,0,0,0,0,0,0,0,0,0,0,0,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0,0},
{0,0,0,0,0,0,0,0,0,0,0,0,0,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0,0},
{0,0,0,0,0,0,0,0,0,0,0,0,0,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0,0},
{0,0,0,0,0,0,0,0,0,0,0,0,0,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0,0},
{0,0,0,0,0,0,0,0,0,0,0,0,0,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0,0},
{0,0,0,0,0,0,63,192,0,0,0,3,252,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0,0},
{0,0,0,0,0,0,63,192,0,0,0,3,252,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0,0},
{0,0,0,0,0,0,63,192,0,0,0,3,252,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0,0},
{0,0,0,0,0,0,63,192,0,0,0,3,252,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0,0},
{0,0,0,0,0,0,63,192,0,0,0,3,252,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0,0},
{0,0,0,0,0,0,63,192,0,0,0,3,252,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0,0},
{0,0,0,0,0,0,63,192,0,0,0,3,252,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0,0},
{0,0,0,0,0,0,63,192,0,0,0,3,252,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0,0},
{0,0,0,0,0,0,63,192,0,0,0,3,252,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0,0},
{0,0,0,0,0,0,3,207,0,0,0,0,0,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0,48},
{0,0,0,0,0,0,15,60,0,0,0,0,0,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0,3},
{0,0,0,0,0,0,60,240,0,0,0,0,0,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0,48},
{0,0,0,0,0,0,243,192,0,0,0,0,0,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0,3},
{0,0,0,0,0,3,207,0,0,0,0,0,0,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0,48},
{0,0,0,0,0,15,60,0,0,0,0,0,0,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0,3},
{0,0,0,0,0,60,240,0,0,0,0,0,0,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0,48},
{0,0,0,0,0,243,192,0,0,0,0,0,0,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0,3},
{0,0,0,0,3,252,0,0,0,0,0,0,0,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0,48},
{0,0,0,0,0,0,0,0,0,0,0,0,0,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0,0},
{0,0,0,0,0,0,0,0,0,0,0,0,0,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0,0},
{0,0,0,0,0,0,0,0,0,0,0,0,0,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0,0},
{0,0,0,0,0,0,0,0,0,0,0,0,0,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0,0},
{0,0,0,0,0,0,0,0,0,0,0,0,0,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0,0},
{0,0,0,0,0,0,0,0,0,0,0,0,0,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0,0},
{0,0,0,0,0,0,0,0,0,0,0,0,0,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0,0},
{0,0,0,0,0,0,0,0,0,0,0,0,0,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0,0},
{0,0,0,0,0,0,0,0,0,0,0,0,0,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0,0}
};
const int px[72]={12,12,12,12,12,12,12,12,12,-48,-40,-32,-26,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12,12};
const int py[72]={100,100,100,100,100,100,100,100,100,100,100,100,100,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102,102};
const int pw[72]={294,294,294,294,294,294,294,294,294,414,398,382,370,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294,294};
const int ph[72]={38,38,38,38,38,38,38,38,38,38,38,38,38,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34,34};
struct Cue {
  uint32_t start;
  uint32_t end;
  uint8_t lyric;
  uint8_t effect;
};

// Effects:
// 0 = Fade
// 1 = Letter spread
// 2 = Curved entry
// 3 = Wobble

const Cue cues[] = {
  {1000, 4400, 0, 0},
  {4700, 8700, 1, 1},
  {9000, 12400, 2, 2},
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  {39200, 42900, 5, 0}
};

const int CUES=10;

const uint32_t CLIP_END = 45558;
const bool REPEAT = true;
const uint32_t FRAME_INTERVAL = 40;

uint32_t origin = 0;
uint32_t lastFrame = 0;
uint32_t lastButton = 0;

bool priorButton = HIGH;

float clamped(float v) {
  return v < 0 ? 0 : v > 1 ? 1 : v;
}

float ease(float v) {
  v = clamped(v);
  return v * v * (3 - 2 * v);
}

uint16_t rgb(
  uint8_t r,
  uint8_t g,
  uint8_t b
) {
  return ((r & 248) << 8) |
         ((g & 252) << 3) |
         (b >> 3);
}

void pixel(int x,int y,uint16_t c){if(x>=0&&x<W&&y>=0&&y<H)tft.fillRect(x*2,y*2-8,2,2,c);}
void line(int x,int y,int a,int b,uint16_t c){tft.drawLine(x*2,y*2-8,a*2,b*2-8,c);}
void circle(int x,int y,int r,uint16_t c){tft.fillCircle(x*2,y*2-8,r*2,c);}
void triangle(int x,int y,int a,int b,int d,int e,uint16_t c){tft.fillTriangle(x*2,y*2-8,a*2,b*2-8,d*2,e*2-8,c);}
// =======================================
// ROSE GRAPHICS
// =======================================

void rose(int x, int y) {

  line(
    x + 5, y + 7,
    x + 2, y + 18,
    rgb(63, 130, 45)
  );

  line(
    x + 4, y + 13,
    x - 1, y + 10,
    rgb(84, 150, 55)
  );

  line(
    x + 4, y + 14,
    x + 9, y + 12,
    rgb(69, 150, 50)
  );

  circle(
    x + 4, y + 5, 4,
    rgb(159, 19, 39)
  );

  circle(
    x + 6, y + 4, 3,
    rgb(214, 28, 51)
  );

  pixel(
    x + 5, y + 3,
    rgb(255, 98, 105)
  );
}

// =======================================
// HEART GRAPHICS
// =======================================

void heart(int x, int y) {

  uint16_t peach =
    rgb(207, 126, 103);

  circle(
    x + 4, y + 5, 5, peach
  );

  circle(
    x + 12, y + 5, 5, peach
  );

  triangle(
    x - 1, y + 7,
    x + 17, y + 7,
    x + 8, y + 18,
    peach
  );
}

// =======================================
// DRAW ANIMATED TEXT
// =======================================

void drawTextFrame(const Cue& c,uint32_t at){
 float in=ease((at-c.start)/560.0);float out=ease((c.end-at)/550.0);float alpha=in<out?in:out;
 int group=0;if(c.lyric==0)group=c.effect==1?1:0;if(c.lyric==1)group=c.effect==1?3:2;if(c.lyric==2)group=4;if(c.lyric==3)group=5;if(c.lyric==4)group=6;if(c.lyric==5)group=7;
 int stage=(int)(in*8);if(stage>8)stage=8;int n=group*9+stage;int v=(int)(alpha*255);
 tft.drawBitmap(px[n],py[n],sprites[n],pw[n],ph[n],rgb(v,v,v));
 if(c.lyric==4&&alpha>.25)rose((160-118)/2+118+3,(128-21)/2-1);
 if(c.lyric==5&&alpha>.25)heart(140,(128-17)/2-1);
}
// =======================================
// RENDER FRAME
// =======================================

void render(uint32_t at) {

  tft.fillScreen(ILI9341_BLACK);

  for (int i = 0; i < CUES; i++) {

    if (at >= cues[i].start &&
        at < cues[i].end) {

      drawTextFrame(cues[i], at);
      break;
    }
  }

  // Ending screen
  if (at >= 43000 && at < CLIP_END) {

    tft.setTextColor(
      rgb(235, 235, 235)
    );

    tft.setTextSize(2);
    tft.setCursor(118, 114);
    tft.print("music....");
  }


}


void setup(){Serial.begin(115200);pinMode(SYNC_PIN,INPUT_PULLUP);SPI.begin(12,13,11,CS);tft.begin();tft.setRotation(1);tft.fillScreen(ILI9341_BLACK);origin=millis();Serial.println("Bengali Lyrics Animation Ready - N16R8 / ILI9341");}
void loop() {

  uint32_t now = millis();

  bool button =
    digitalRead(SYNC_PIN);

  if (
    priorButton == HIGH &&
    button == LOW &&
    (now - lastButton) > 200
  ) {

    origin = now;
    lastButton = now;

    Serial.println(
      "Animation restarted"
    );
  }

  priorButton = button;

  while (Serial.available()) {

    if (Serial.read() == 's') {
      origin = now;

      Serial.println(
        "Serial synchronization"
      );
    }
  }

  uint32_t at = now - origin;

  if (at >= CLIP_END && REPEAT) {
    origin = now;
    at = 0;
  }

  if (
    now - lastFrame >= FRAME_INTERVAL
  ) {

    lastFrame = now;
    render(at);
  }
  delay(5);
}
