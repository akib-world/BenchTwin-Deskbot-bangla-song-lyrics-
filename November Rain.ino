// Deskbot lyrics on the 160 x 128 ST7735 Black Tab.
#include <Arduino.h>
#include <SPI.h>
#include <Adafruit_GFX.h>
#include <Adafruit_ST7735.h>
#include <math.h>

#define CS 5
#define DC 2
#define RST 4
#define SYNC_PIN 27
#define TFT_TAB INITR_BLACKTAB

Adafruit_ST7735 tft(CS, DC, RST);
bool previousButton = HIGH;
unsigned long lastRestart = 0;

const unsigned long CLIP_MS = 127027;
const int COUNT = 12;
const unsigned long starts[12]={7074,21355,33600,45579,58458,68168,73040,81248,85052,94828,107841,117784};
const unsigned long ends[12]={14148,30330,39039,51585,67500,72372,80580,84384,91891,100967,114180,127027};
unsigned long epoch=0;
int lastCue=-1;
int screenW=160,screenH=128,fontScale=1;

const uint16_t backdrop[10052]={
0,0,160,49950,0,1,160,54046,0,2,160,54046,0,3,160,54046,0,4,160,54046,0,5,160,54046,0,6,160,54046,0,7,160,54046,
0,8,160,54046,0,9,160,54046,0,10,160,54046,0,11,160,54046,0,12,160,54046,0,13,160,54046,0,14,160,54046,0,15,160,54046,
0,16,160,54046,0,17,160,53918,0,18,160,53918,0,19,160,53918,0,20,160,53918,0,21,160,53918,0,22,160,53918,0,23,160,58014,
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159,119,1,50712
};
void background(bool lyricsOnly) {
  tft.startWrite();
  for(int i=0;i<10052;i+=4) {
    const int row = backdrop[i+1];
    const int y = row * screenH / 120;
    const int h = (row + 1) * screenH / 120 - y;
    if (lyricsOnly && (y < 25 || y >= 85)) continue;
    tft.writeFillRect(backdrop[i],y,backdrop[i+2],h,backdrop[i+3]);
  }
  tft.endWrite();
}
void lineText(const char* text,int row,int rows) {
  int length=0;
  while(text[length]!=0) length++;
  int size=fontScale;
  while(size>1 && length*6*size>screenW-10) size--;
  int pitch=12*fontScale;
  int x=(screenW-length*6*size)/2;
  int y=(screenH-rows*pitch)/2-14+row*pitch+2*fontScale;
  tft.setTextSize(size);
  tft.setTextColor(tft.color565(65,25,80));
  tft.setCursor(x+2,y+2); tft.print(text);
  tft.setTextColor(ST77XX_WHITE);
  tft.setCursor(x,y); tft.print(text);
}
void drawCue(int cue) {
  background(true);
  switch(cue) {
    case 0:
      lineText("WHEN I LOOK INTO",0,4);
      lineText("YOUR EYES",1,4);
      lineText("I CAN SEE A LOVE",2,4);
      lineText("RESTRAINED",3,4);
      break;
    case 1:
      lineText("BUT, DARLIN', WHEN I",0,4);
      lineText("HOLD YOU",1,4);
      lineText("DON'T YOU KNOW I FEEL",2,4);
      lineText("THE SAME? YEAH",3,4);
      break;
    case 2:
      lineText("NOTHIN' LASTS FOREVER",0,3);
      lineText("AND WE BOTH KNOW",1,3);
      lineText("HEARTS CAN CHANGE",2,3);
      break;
    case 3:
      lineText("AND IT'S HARD TO",0,3);
      lineText("HOLD A CANDLE",1,3);
      lineText("IN THE COLD NOVEMBER RAIN",2,3);
      break;
    case 4:
      lineText("WE'VE BEEN THROUGH THIS",0,4);
      lineText("SUCH A LONG, LONG TIME",1,4);
      lineText("JUST TRYNA KILL THE PAIN,",2,4);
      lineText("OOH YEAH",3,4);
      break;
    case 5:
      lineText("BUT LOVERS ALWAYS COME",0,2);
      lineText("AND LOVERS ALWAYS GO",1,2);
      break;
    case 6:
      lineText("AND NO ONE'S REALLY SURE",0,3);
      lineText("WHO'S LETTIN' GO TODAY,",1,3);
      lineText("WALKIN' AWAY",2,3);
      break;
    case 7:
      lineText("IF WE COULD TAKE THE",0,3);
      lineText("TIME TO LAY IT",1,3);
      lineText("ON THE LINE",2,3);
      break;
    case 8:
      lineText("I COULD REST MY HEAD,",0,3);
      lineText("JUST KNOWIN' THAT YOU",1,3);
      lineText("WERE MINE, ALL MINE",2,3);
      break;
    case 9:
      lineText("SO, IF YOU WANT",0,4);
      lineText("TO LOVE ME",1,4);
      lineText("THEN, DARLIN',",2,4);
      lineText("DON'T REFRAIN",3,4);
      break;
    case 10:
      lineText("OR I'LL JUST END UP",0,3);
      lineText("WALKIN' IN THE COLD",1,3);
      lineText("NOVEMBER RAIN",2,3);
      break;
    case 11:
      lineText("DO YOU NEED SOME TIME",0,4);
      lineText("ON YOUR OWN?",1,4);
      lineText("DO YOU NEED SOME TIME",2,4);
      lineText("ALL ALONE?",3,4);
      break;
  }
}
// The upper backdrop rows are solid across the width.
uint16_t skyColors[128];
constexpr int SPARK_COUNT = 18;
int16_t sparkX[SPARK_COUNT], sparkY[SPARK_COUNT];
bool trailVisible = false;
unsigned long lastTrailFrame = 0;

void clearTrail() {
  if (!trailVisible) return;
  for (int i = 0; i < SPARK_COUNT; ++i) {
    tft.drawPixel(sparkX[i], sparkY[i], skyColors[sparkY[i]]);
  }
  trailVisible = false;
}

void drawTrail(unsigned long elapsed) {
  clearTrail();
  const float phase = (elapsed % 2400) / 2400.0f;
  for (int i = 0; i < SPARK_COUNT; ++i) {
    const float angle = 6.2831853f * (phase - i * 0.007f);
    const float sine = sinf(angle);
    sparkX[i] = 80 + (int)(40.0f * sine * sine * sine);
    sparkY[i] = 49 - (int)(2.0f * (13.0f * cosf(angle)
        - 5.0f * cosf(2.0f * angle) - 2.0f * cosf(3.0f * angle)
        - cosf(4.0f * angle)));
    const uint16_t color = i < 6 ? ST77XX_WHITE : tft.color565(247, 189, 246);
    tft.drawPixel(sparkX[i], sparkY[i], color);

  }
  trailVisible = true;
}

void setup() {
  Serial.begin(115200);
  pinMode(SYNC_PIN, INPUT_PULLUP);
  SPI.begin(18, -1, 23, CS);
  tft.initR(TFT_TAB);
  tft.setSPISpeed(27000000);
  tft.setRotation(1);
  screenW=tft.width(); screenH=tft.height();
  fontScale=screenW/160;
  if(fontScale<1) fontScale=1;
  tft.setTextWrap(false);
  for (size_t i = 0; i < sizeof(backdrop) / sizeof(backdrop[0]); i += 4) {
    const int row = backdrop[i+1];
    if (row >= 94) break;
    for (int y = row * screenH / 120; y < (row + 1) * screenH / 120; ++y) {
      skyColors[y] = backdrop[i+3];
    }
  }
  background(false);
  epoch=millis();
}
void loop() {
  const unsigned long now = millis();
  const bool button = digitalRead(SYNC_PIN);
  if (previousButton == HIGH && button == LOW && now - lastRestart >= 200) {
    epoch = now;
    lastRestart = now;
  }
  previousButton = button;
  while (Serial.available()) {
    if (Serial.read() == 's') epoch = now;
  }
  unsigned long elapsed = (now - epoch) % CLIP_MS;
  int cue=-1;
  for(int i=0;i<COUNT;i++) {
    if(elapsed>=starts[i] && elapsed<ends[i]) cue=i;
  }
  // Paint only on cue changes: no full-screen clear/redraw every loop.
  if (cue != lastCue) {
    clearTrail();
    drawCue(cue);
    lastCue = cue;
  }
  if (cue == -1 && now - lastTrailFrame >= 40) {
    drawTrail(elapsed);
    lastTrailFrame = now;
  }
  delay(10);
}
